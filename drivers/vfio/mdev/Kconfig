## drivers/vfio/mdev/Kconfig
```kconfig
# SPDX-License-Identifier: GPL-2.0-only

config VFIO_MDEV
	tristate "Mediated device driver framework"
	depends on VFIO
	default n
	help
	  Provides a framework to virtualize devices.
	  See Documentation/driver-api/vfio-mediated-device.rst for more details.

	  If you don't know what do here, say N.

config VFIO_MDEV_IRQS
	bool "Mediated device driver common lib code for interrupts"
	depends on VFIO_MDEV
	select IMS_MSI_ARRAY
	select IRQ_BYPASS_MANAGER
	default n
	help
	  Provide common library code to deal with IMS interrupts for mediated
	  devices.

	  If you don't know what to do here, say N.
```
